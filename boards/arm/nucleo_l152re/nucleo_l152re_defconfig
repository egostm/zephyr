## boards/arm/nucleo_l152re/nucleo_l152re_defconfig
```kconfig
# SPDX-License-Identifier: Apache-2.0

CONFIG_ARM=y
CONFIG_SOC_SERIES_STM32L1X=y
CONFIG_SOC_STM32L152XE=y
CONFIG_CORTEX_M_SYSTICK=y
# 32MHz system clock
CONFIG_SYS_CLOCK_HW_CYCLES_PER_SEC=16000000

# enable uart driver
CONFIG_SERIAL=y
# enable console

CONFIG_CONSOLE=y
CONFIG_UART_CONSOLE=y

# enable pinmux
CONFIG_PINMUX=y

# enable GPIO
CONFIG_GPIO=y

# clock configuration
CONFIG_CLOCK_CONTROL=y
# SYSCLK selection
CONFIG_CLOCK_STM32_SYSCLK_SRC_PLL=y
# Use HSI source
CONFIG_CLOCK_STM32_PLL_SRC_HSI=y
CONFIG_CLOCK_STM32_PLL_DIVISOR=3
# produce 32Mhz clock at PLL output
CONFIG_CLOCK_STM32_PLL_MULTIPLIER=6
CONFIG_CLOCK_STM32_AHB_PRESCALER=1
CONFIG_CLOCK_STM32_APB1_PRESCALER=1

#enable MPU
CONFIG_ARM_MPU=y

CONFIG_OPENOCD_SUPPORT=y

CONFIG_ASSERT=y

# Clock configuration for Cube Clock control driver
#CONFIG_CLOCK_STM32_HSE_CLOCK=8000000
#CONFIG_CLOCK_STM32_SYSCLK_SRC_PLL=y
## use HSE as PLL input
#CONFIG_CLOCK_STM32_PLL_SRC_HSE=y
## however, the board does not have an external oscillator, so just use
## the 8MHz clock signal coming from integrated STLink
#CONFIG_CLOCK_STM32_HSE_BYPASS=y
```

## dts/bindings/clock/st,stm32f4-pll-clock.yaml
```yaml
# Copyright (c) 2021, Linaro ltd
# SPDX-License-Identifier: Apache-2.0

description: STM32F4 PLL

compatible: "st,stm32f4-pll-clock"

include: [clock-controller.yaml, base.yaml]

properties:
    "#clock-cells":
      const: 0

    clocks:
      required: true

    div-m:
      type: int
      required: true
      description: |
          Division factor for the main PLL (PLL) input clock
          Valid range: 2 - 63

    mul-n:
      type: int
      required: true
      description: |
          Main PLL multiplication factor for VCO
          Valid range: 50 - 432

    div-p:
      type: int
      required: false
      description: |
          Main PLL division factor for PLLSAI2CLK
      enum:
        - 2
        - 4
        - 6
        - 8

    div-q:
      type: int
      required: false
      description: |
          Main PLL (PLL) division factor for USB OTG FS, SDMMC and random number
          generator clocks.
          Valid range: 2 - 15

    div-r:
      type: int
      required: false
      description: |
          Main PLL division factor for DSI clock
          Valid range: 2 - 7
```

## dts/bindings/clock/st,stm32l4-pll-clock.yaml
```yaml
# Copyright (c) 2021, Linaro ltd
# SPDX-License-Identifier: Apache-2.0

description: STM32L4 PLL

compatible: "st,stm32l4-pll-clock"

include: [clock-controller.yaml, base.yaml]

properties:
    "#clock-cells":
      const: 0

    clocks:
      required: true

    div-m:
      type: int
      required: true
      description: |
          Division factor for the main PLL and audio PLL
          (PLLSAI1 and PLLSAI2) input clock
          Valid range: 1 - 8

    mul-n:
      type: int
      required: true
      description: |
          Main PLL multiplication factor for VCO
          Valid range: 8 - 86

    div-p:
      type: int
      required: false
      description: |
          Main PLL division factor for PLLSAI3CLK
          (PLLSAI1 and PLLSAI2) input clock
      enum:
        - 7
        - 17

    div-q:
      type: int
      required: false
      description: |
          Main PLL division factor for PLL48M1CLK (48 MHz clock).
      enum:
        - 2
        - 4
        - 6
        - 8

    div-r:
      type: int
      required: true
      description: |
          Main PLL division factor for PLLCLK (system clock)
      enum:
        - 2
        - 4
        - 6
        - 8
```

## dts/bindings/clock/st,stm32wb-pll-clock.yaml
```yaml
# Copyright (c) 2021, Linaro ltd
# SPDX-License-Identifier: Apache-2.0

description: STM32WB PLL

compatible: "st,stm32wb-pll-clock"

include: st,stm32l4-pll-clock.yaml

properties:
    mul-n:
      description: |
          Main PLL multiplication factor for VCO
          Valid range: 6 - 127

    div-p:
      description: |
          Main PLL division factor for PLLSAI3CLK
          (PLLSAI1 and PLLSAI2) input clock
          Valid range: 2 - 32

    div-q:
      description: |
          Main PLL division factor for PLL48M1CLK (48 MHz clock).
          Valid range: 2 - 8

    div-r:
      description: |
          Main PLL division factor for PLLCLK (system clock)
          Valid range: 2 - 8
```

## dts/bindings/flash_controller/st,stm32g4-flash-controller.yaml
```yaml
title: STM32 G4 Flash Controller

description: >
    This binding gives a base representation of the STM32 G4 Flash Controller

inherits:
    !include flash-controller.yaml

properties:
    compatible:
      constraint: "st,stm32g4-flash-controller"
```
